## sdkconfig.defaults
```kconfig
# Target hardware
CONFIG_IDF_TARGET="esp32s3"

# Optimization: Essential for fitting into 1MB partitions
CONFIG_COMPILER_OPTIMIZATION_SIZE=y

# Bluetooth: Enable and use NimBLE (Saves ~300KB Flash over Bluedroid)
CONFIG_BT_ENABLED=y
CONFIG_BT_CONTROLLER_ENABLED=y
CONFIG_BT_BLUEDROID_ENABLED=n
CONFIG_BT_NIMBLE_ENABLED=y

# Provisioning Settings
# Note: Bonding and Notify are disabled to keep it simple and small
CONFIG_NETWORK_PROV_BLE_BONDING=n
CONFIG_NETWORK_PROV_BLE_NOTIFY=n

# Debug output to USB instead of UART.
CONFIG_ESP_CONSOLE_UART_DEFAULT=n
CONFIG_ESP_CONSOLE_USB_SERIAL_JTAG=y

# Enable Security 1 (X25519 + AES-CTR)
# Disable Security 2 (SRP6a) to save space and avoid Cache Errors
CONFIG_ESP_PROTOCOMM_SUPPORT_SECURITY_VERSION_1=y
CONFIG_ESP_PROTOCOMM_SUPPORT_SECURITY_VERSION_2=n
```
